## examples/ahrs_imusensor/Kconfig
```kconfig
config EXAMPLES_AHRS_IMUSENSOR
	tristate "Calculate attitude (roll, pitch, yaw) using IMU sensor fusion"
	default n
	depends on SENSORS_CXD5602PWBIMU
	---help---
		Enable the ahrs_imusensor app

if EXAMPLES_AHRS_IMUSENSOR

config EXAMPLES_AHRS_IMUSENSOR_PROGNAME
	string "Program name"
	default "ahrs_imusensor"
	---help---
		This is the name of the program that will be use when the NSH ELF
		program is installed.

config EXAMPLES_AHRS_IMUSENSOR_PRIORITY
	int "ahrs_imusensor task priority"
	default 100

config EXAMPLES_AHRS_IMUSENSOR_STACKSIZE
	int "ahrs_imusensor stack size"
	default 2048

endif
```

## examples/gnsssensor/Kconfig
```kconfig
config EXAMPLES_GNSSSENSOR
	tristate "Enable gnsssensor command that returns gnss data"
	default y
    depends on CXD56_GNSS || CXD56_GNSS_ADDON
	---help---
		Enable the gnsssensor app

if EXAMPLES_GNSSSENSOR

config EXAMPLES_GNSSSENSOR_PROGNAME
	string "Program name"
	default "gnsssensor"
	---help---
		This is the name of the program that will be use when the NSH ELF
		program is installed.

config EXAMPLES_GNSSSENSOR_PRIORITY
	int "gnsssensor task priority"
	default 100

config EXAMPLES_GNSSSENSOR_STACKSIZE
	int "gnsssensor stack size"
	default 2048

endif
```

## examples/gyrocompass_imusensor/Kconfig
```kconfig
config EXAMPLES_GYROCOMPASS_IMUSENSOR
	tristate "Obtain gyrocompass data from IMU Board"
	default n
	depends on SENSORS_CXD5602PWBIMU
	depends on IMU_UTILS
	---help---
		Enable the gyrocompass imusensor app

if EXAMPLES_GYROCOMPASS_IMUSENSOR

config EXAMPLES_GYROCOMPASS_IMUSENSOR_PROGNAME
	string "Program name"
	default "gyrocompass_imusensor"
	---help---
		This is the name of the program that will be use when the NSH ELF
		program is installed.

config EXAMPLES_GYROCOMPASS_IMUSENSOR_PRIORITY
	int "gyrocompass_imusensor task priority"
	default 100

config EXAMPLES_GYROCOMPASS_IMUSENSOR_STACKSIZE
	int "gyrocompass_imusensor stack size"
	default 4096

endif
```

## examples/imu_utils/Kconfig
```kconfig
config IMU_UTILS
	bool "Utitiy functions for IMU sensor"
	default n
	depends on SENSORS_CXD5602PWBIMU
	---help---
		Enables the utility library.
```

## examples/imusensor/Kconfig
```kconfig
config EXAMPLES_IMUSENSOR
	tristate "Obtain linear and gyro acceleration from IMU Board"
	default n
    depends on SENSORS_CXD5602PWBIMU
	---help---
		Enable the imusensor app

if EXAMPLES_IMUSENSOR

config EXAMPLES_IMUSENSOR_PROGNAME
	string "Program name"
	default "imusensor"
	---help---
		This is the name of the program that will be use when the NSH ELF
		program is installed.

config EXAMPLES_IMUSENSOR_PRIORITY
	int "imusensor task priority"
	default 100

config EXAMPLES_IMUSENSOR_STACKSIZE
	int "imusensor stack size"
	default 2048

endif
```

## examples/serial_controller/Kconfig
```kconfig
config EXAMPLES_SERIAL_CONTROLLER
	tristate "Communicate between Pro-T and Spresense using JSON"
	default y
  depends on NETUTILS_CJSON && SYSTEM_POPEN
	---help---
		Enable the serial_controller app

if EXAMPLES_SERIAL_CONTROLLER

config EXAMPLES_SERIAL_CONTROLLER_PROGNAME
	string "Program name"
	default "serial_controller"
	---help---
		This is the name of the program that will be use when the NSH ELF
		program is installed.

config EXAMPLES_SERIAL_CONTROLLER_PRIORITY
	int "serial_controller task priority"
	default 100

config EXAMPLES_SERIAL_CONTROLLER_STACKSIZE
	int "serial_controller stack size"
	default 2048

endif
```

## examples/spitest/Kconfig
```kconfig
config EXAMPLES_SPITEST
	tristate "SPI test for mcp2515"
	default n
	---help---
		Enable the spitest app

if EXAMPLES_SPITEST

config EXAMPLES_SPITEST_PROGNAME
	string "Program name"
	default "spitest"
	---help---
		This is the name of the program that will be use when the NSH ELF
		program is installed.

config EXAMPLES_SPITEST_PRIORITY
	int "spitest task priority"
	default 100

config EXAMPLES_SPITEST_STACKSIZE
	int "spitest stack size"
	default 2048

endif
```

## examples/sprinfo/Kconfig
```kconfig
config EXAMPLES_SPRINFO
	tristate "Get spresense version"
	default y
	---help---
		Enable the sprinfo app

if EXAMPLES_SPRINFO

config EXAMPLES_SPRINFO_PROGNAME
	string "Program name"
	default "sprinfo"
	---help---
		This is the name of the program that will be use when the NSH ELF
		program is installed.

config EXAMPLES_SPRINFO_PRIORITY
	int "sprinfo task priority"
	default 100

config EXAMPLES_SPRINFO_STACKSIZE
	int "sprinfo stack size"
	default 1024

endif
```
